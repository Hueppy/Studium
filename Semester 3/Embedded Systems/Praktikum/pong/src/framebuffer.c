#include "framebuffer.h"

static uint8_t font[FONT_N][FONT_W] = {
  {0x00, 0x7e, 0x7e, 0x7e, 0x00, 0x00},
  {0x10, 0x38, 0x7c, 0x3e, 0x1c, 0x08},
  {0x1c, 0x1c, 0x1c, 0x1c, 0x1c, 0x1c},
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  {0x10, 0x18, 0x14, 0x12, 0x14, 0x18},
};

void fb_init(framebuffer *fb) {
    fb->mutex = xSemaphoreCreateMutex();
}

void fb_clear(framebuffer *fb) {
    if (xSemaphoreTake(fb->mutex, portMAX_DELAY) == pdTRUE) {
        uint8_t i;
        for (i = 0U; i < (DISP_H / 8U); i++) {
            uint8_t j;
            for (j = 0U; j < DISP_W; j++) {
                fb->buffer[j][i] = 0x00U;
            }
        }
        xSemaphoreGive(fb->mutex);
    }
}

void fb_draw_line(framebuffer *fb, uint8_t x1, uint8_t y1, uint8_t x2, uint8_t y2) {
    // make sure first argument is less than second argument, swap if needed
    uint8_t x_start = x1;
    uint8_t x_stop = x2;
    if (x_start > x_stop) {
        uint8_t t = x_start;
        x_start = x_stop;
        x_stop = t;
    }

    uint8_t y_start = y1;
    uint8_t y_stop = y2;
    if (y_start > y_stop) {
        uint8_t t = y_start;
        y_start = y_stop;
        y_stop = t;
    }

    if (xSemaphoreTake(fb->mutex, portMAX_DELAY) == pdTRUE) {
        if (y_start == y_stop) {
            /* optimized case for horizontal line */
            uint8_t row = y_start / 8U;
            uint8_t data = 1U << (y_start % 8U);
            uint8_t i;
            for (i = x_start; i < x_stop; i++) {
                fb->buffer[i][row] |= data;
            }
        } else if (x_start == x_stop) {
            /* optimized case for vertical line */
            uint8_t first_row = y_start / 8U;
            uint8_t last_row = y_stop / 8U;
                
            uint8_t start_mask = 0xFFU << (y_start % 8U);
            uint8_t stop_mask = 0xFFU >> (8U - (y_stop % 8U));
                
            if (first_row == last_row) {
                fb->buffer[x_start][first_row] |= start_mask & stop_mask;
            } else {
                uint8_t i;
                fb->buffer[x_start][first_row] |= start_mask;
                for (i = first_row + 1U; i < last_row; i++) {
                    fb->buffer[x_start][i] |= 0xFF;
                }
                fb->buffer[x_start][last_row] |= stop_mask;
            }
        } else {
            /* Implement this when needed */
        }
        xSemaphoreGive(fb->mutex);
    }
}

void fb_draw_rectangle(framebuffer *fb, uint8_t x, uint8_t y, uint8_t width, uint8_t height) {
    uint8_t i;
    for (i = 0U; i < width; i++) {
        fb_draw_line(fb, x + i, y, x + i, y + height);
    }
}

void fb_print_char(framebuffer *fb, char c, uint8_t line, uint8_t column) {
    uint8_t i;
    uint8_t col = column;
    for (i = 0; i < FONT_W; i++) {
        fb->buffer[col][line] |= font[c][i];
        col++;
    }
}

void fb_print(framebuffer *fb, char *string, uint8_t line, uint8_t column, print_direction dir) {
    uint8_t l = line;
    uint8_t c = column;
    char *s = string;

    if (dir == LEFT_TO_RIGHT) {
	    while (*s != '\0'){
		    fb_print_char(fb, *s, l, c);
        
            c += FONT_W + 1;

            if (c >= (DISP_W - FONT_W)) {
                c = 0;
                l++;
            }

            s++;
        }
    } else {
        while (*s != '\0') {
            s++;
        }

        c -= FONT_W;

        while (--s >= string) {
		    fb_print_char(fb, *s, l, c - FONT_W);
        
            c -= FONT_W + 1;

            if (c < FONT_W) {
                c = DISP_W - FONT_W;
                l--;
            }
        }
    }
}

void fb_paint(framebuffer *fb) {
    if (xSemaphoreTake(fb->mutex, portMAX_DELAY) == pdTRUE) {
        mode_data();
    
        uint8_t i;
        for (i = 0U; i < (DISP_H / 8U); i++) {
            set_xrow(0, i);
            uint8_t j;
            for (j = 0; j < DISP_W; j++) {
              spi(fb->buffer[j][i]);
            }
        }
        xSemaphoreGive(fb->mutex);
    }
}
